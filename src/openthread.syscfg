/*
 * Copyright (c) 2018, Texas Instruments Incorporated
 * All rights reserved.
 *
 * Redistribution and use in source and binary forms, with or without
 * modification, are permitted provided that the following conditions
 * are met:
 *
 * *  Redistributions of source code must retain the above copyright
 *    notice, this list of conditions and the following disclaimer.
 *
 * *  Redistributions in binary form must reproduce the above copyright
 *    notice, this list of conditions and the following disclaimer in the
 *    documentation and/or other materials provided with the distribution.
 *
 * *  Neither the name of Texas Instruments Incorporated nor the names of
 *    its contributors may be used to endorse or promote products derived
 *    from this software without specific prior written permission.
 *
 * THIS SOFTWARE IS PROVIDED BY THE COPYRIGHT HOLDERS AND CONTRIBUTORS "AS IS"
 * AND ANY EXPRESS OR IMPLIED WARRANTIES, INCLUDING, BUT NOT LIMITED TO,
 * THE IMPLIED WARRANTIES OF MERCHANTABILITY AND FITNESS FOR A PARTICULAR
 * PURPOSE ARE DISCLAIMED. IN NO EVENT SHALL THE COPYRIGHT OWNER OR
 * CONTRIBUTORS BE LIABLE FOR ANY DIRECT, INDIRECT, INCIDENTAL, SPECIAL,
 * EXEMPLARY, OR CONSEQUENTIAL DAMAGES (INCLUDING, BUT NOT LIMITED TO,
 * PROCUREMENT OF SUBSTITUTE GOODS OR SERVICES; LOSS OF USE, DATA, OR PROFITS;
 * OR BUSINESS INTERRUPTION) HOWEVER CAUSED AND ON ANY THEORY OF LIABILITY,
 * WHETHER IN CONTRACT, STRICT LIABILITY, OR TORT (INCLUDING NEGLIGENCE OR
 * OTHERWISE) ARISING IN ANY WAY OUT OF THE USE OF THIS SOFTWARE,
 * EVEN IF ADVISED OF THE POSSIBILITY OF SUCH DAMAGE.
 */

/*
 *  cli_ftd.syscfg
 */

/* Modules */
var AESECB    = scripting.addModule("/ti/drivers/AESECB");
var Device    = scripting.addModule("/ti/devices/CCFG");
var GPIO      = scripting.addModule("/ti/drivers/GPIO");
var NVS       = scripting.addModule("/ti/drivers/NVS");
var RF        = scripting.addModule("/ti/drivers/RF");
var RFCustom  = scripting.addModule("/ti/devices/radioconfig/custom");
var RFDesign  = scripting.addModule("/ti/devices/radioconfig/rfdesign");
var CCFG      = scripting.addModule("/ti/devices/CCFG");
var SPI       = scripting.addModule("/ti/drivers/SPI");
var TRNG      = scripting.addModule("/ti/drivers/TRNG");
var UART2     = scripting.addModule("/ti/drivers/UART2");
var Watchdog  = scripting.addModule("/ti/drivers/Watchdog");


/* Instances */
var AESECB     = AESECB.addInstance();
var GPIO5      = GPIO.addInstance();
var NVS1       = NVS.addInstance();
var NVSDGB     = NVS.addInstance();
var SPI2       = SPI.addInstance();
var TRNG1      = TRNG.addInstance();
var UART2      = UART2.addInstance();
var Watchdog1  = Watchdog.addInstance();

const deviceId = system.deviceData.deviceId;


/* CCFG */
const ccfgSettings = system.getScript("/ti/common/lprf_ccfg_settings.js").ccfgSettings;
for(var setting in ccfgSettings)
{
    Device[setting] = ccfgSettings[setting];
}

/**
 * Write custom configuration values to the imported modules.
 */
CCFG.enableBootloader         = true;
CCFG.enableBootloaderBackdoor = true;
CCFG.dioBootloaderBackdoor    = 14;
CCFG.levelBootloaderBackdoor  = "Active low";
// CCFG.forceVddr                = true;
CCFG.ccfgTemplate.$name       = "ti_devices_CCFG_CCFGCC26XXTemplate0";

RFDesign.rfDesign = "LP_CC1352P7-4";
RFDesign.fbSub1g  = "none";
RFDesign.fb24g  = "fb2400";

RF.pinSelectionAntenna                      = 1;
RF.rfAntennaPinSymbol0                      = "CONFIG_RF_HIGH_PA";
RF.globalEventMask                          = ["RF_GlobalEventRadioPowerDown","RF_GlobalEventRadioSetup"];
RF.rfAntennaPin0.$assign                    = "DIO_29";
RF.rfAntennaPin0Instance.initialOutputState = scripting.forceWrite("Low");

// RF.rfAntennaPinSymbol1                      = "CONFIG_RF_24GHZ_CONST";
// RF.rfAntennaPinSymbol2                      = "CONFIG_RF_SUB1GHZ_CONST";
// RF.rfAntennaPin0.$assign                    = "DIO_28";
// RF.rfAntennaPin0Instance.initialOutputState = scripting.forceWrite("Low");
// RF.rfAntennaPin2.$assign                    = "DIO_30";
// RF.rfAntennaPin2Instance.initialOutputState = scripting.forceWrite("Low");

/*
 * scripting.suppress("The board \'CC1352P7-4 LaunchPad\' requires the \'RF Antenna Switch\' to be selected\\.", RF, "$hardware");
 * scripting.suppress("Connected to hardware,@@@.+?@@@ is connected to SKY13317-373LF RF Antenna Switch on the CC1352P7-4 LaunchPad\\. Consider selecting it in \'use hardware\' above\\. @@@.+?@@@", RF, "rfAntennaPin0");
 */


/* UART */
UART2.$hardware                   = system.deviceData.board.components.XDS110UART;
UART2.$name                       = "CONFIG_UART2_0";

/* SPI for NCP */
SPI2.$name                   = "CONFIG_SPI_1";
SPI2.mode                    = "Four Pin SS Active Low";
SPI2.spi.pociPin.$assign     = "DIO24"
SPI2.spi.picoPin.$assign     = "DIO25"
SPI2.spi.sclkPin.$assign     = "DIO26"
SPI2.spi.csnPin.$assign      = "DIO27"

GPIO5.$name                  = "CONFIG_SPINEL_INT";
GPIO5.mode                   = "Output";
GPIO5.outputStrength         = "High";
GPIO5.initialOutputState     = "High";
GPIO5.gpioPin.$assign        = "DIO16";


/* NVS */
NVS1.$name = "CONFIG_NVSINTERNAL";
NVSDGB.$name = "CONFIG_NVS_DBG_INTERNAL";


/* place at the end of Flash */
if(deviceId.match(/CC((13|26).2(R|RB|P)7)/))
{
    NVS1.internalFlash.regionBase = 0xAA000;
    NVS1.internalFlash.regionSize = 0x4000;
    NVSDGB.internalFlash.regionBase = 0xA8000;
    NVSDGB.internalFlash.regionSize = 0x2000;
}
else if(deviceId.match(/CC((13|26).2(R|RB|P)1)/))
{
    NVS1.internalFlash.regionBase = 0x52000;
    NVS1.internalFlash.regionSize = 0x4000;
    NVSDGB.internalFlash.regionBase = 0x50000;
    NVSDGB.internalFlash.regionSize = 0x2000;
}
else if(deviceId.match(/CC((13|26).4P10)/))
{
    NVS1.internalFlash.regionBase = 0xFC000;
    NVS1.internalFlash.regionSize = 0x4000;
    NVSDGB.internalFlash.regionBase = 0xFB800;
    NVSDGB.internalFlash.regionSize = 0x800;
    
}
else if(deviceId.match(/CC((13|26).3P10)/))
{
    NVS1.internalFlash.regionBase = 0xFC000;
    NVS1.internalFlash.regionSize = 0x4000;
    NVSDGB.internalFlash.regionBase = 0xFB800;
    NVSDGB.internalFlash.regionSize = 0x800;
}
else
{
    throw new Error("Could not set NVS location for deviceId: " + deviceId);
}


/* Watchdog */
Watchdog1.$name             = "CONFIG_WATCHDOG0";
Watchdog1.period            = 1000;
Watchdog1.watchdog.$assign  = "WDT0";

/* TRNG */
TRNG1.$name  = "CONFIG_TRNG_THREAD";

/* AES */
AESECB.$name = "CONFIG_AESECB_MBEDTLS";

/* RF */

/* if an antenna component exists, assign it to the rf instance */
if (system.deviceData.board && system.deviceData.board.components.RF) {
    RF.$hardware = system.deviceData.board.components.RF;
}

const rfDesignSettings = system.getScript("/ti/common/lprf_rf_design_settings.js").rfDesignSettings;
for(var setting in rfDesignSettings)
{
    RFDesign[setting] = rfDesignSettings[setting];
}

/* Handling for RF frontend characterization */
if(RFDesign.rfDesign.match(/LP_CC2652PSIP/))
{
    RFCustom.ieee = ["ieee154p10"];
    var rfCodeExportConfig = RFCustom.radioConfigieee154p10.codeExportConfig
    RFCustom.radioConfigieee154p10.highPA = true;
}
else
{
    RFCustom.ieee = ["ieee154"];
    var rfCodeExportConfig = RFCustom.radioConfigieee154.codeExportConfig
    RFCustom.radioConfigieee154.highPA = true;
    RFCustom.radioConfigieee154.txPowerHi = "10";
    RFCustom.radioConfigieee154.codeExportConfig.txPower = "20";
}

var cmdList = [
    "cmdIeeeTx",
    "cmdIeeeRx",
    "cmdIeeeCsma",
    "cmdIeeeEdScan",
    "cmdIeeeRxAck",
    "cmdTxTest",
    "cmdRxTest",
];

// "cmdFs",

rfCodeExportConfig.useConst     = true;
rfCodeExportConfig.useMulti     = true;
rfCodeExportConfig.symGenMethod = "Custom";
// rfCodeExportConfig.paExport = "combined";

// Add high PA options if present
if(deviceId.match(/CC(265[12]R|2674R|1352R1|1354R)/))
{
    cmdList.push("cmdRadioSetup");
    rfCodeExportConfig.cmdRadioSetup = "RF_cmdIeeeRadioSetup";
}
else if(deviceId.match(/CC(265[12]P|2674P|1352P)/))
{
    cmdList.push("cmdRadioSetupPa");
    rfCodeExportConfig.cmdRadioSetupPa = "RF_cmdIeeeRadioSetup";
    rfCodeExportConfig.paExport = "combined";
}
else if(deviceId.match(/CC(265[34]|1354)P/))
{
    cmdList.push("cmdRadioSetupPa");
    rfCodeExportConfig.cmdRadioSetupPa = "RF_cmdIeeeRadioSetup";
    // currently not characterized for high PA
}
else
{
    throw new Error("Could not set RF settings for deviceId: " + deviceId);
}

rfCodeExportConfig.cmdList_ieee_15_4 = cmdList;

/* IEEE Coex configuration */
// Disabled by default.
/*
RF.coexEnable                               = true;
RF.coexPhy                                  = ["ieee_15_4"];
RF.rfCoexRequestPin.$assign                 = "DIO_5";
RF.rfCoexPriorityPin.$assign                = "DIO_17";
RF.rfCoexGrantPin.$assign                   = "DIO_18";
RF.rfCoexGrantPinInstance.pull              = "Pull Up";
*/
